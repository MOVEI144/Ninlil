## embedded/esp32s3/components/ninlil_network/Kconfig
```kconfig
menu "Ninlil experimental adaptation"
config NINLIL_ADAPTIVE_MAC_EXPERIMENTAL
    bool "Enable airtime DRR instead of legacy packet-count scheduling"
    default n
    help
        Experimental opt-in for the reference radio pump. Changes local queue
        scheduling only; not frequency, output limits, security or membership.
        Uses 10 ms base quantum, 8:4:3:1 airtime weights, and at most 50 ms
        urgent bypass while a large packet accumulates radio credit.
        Rebuild all consumers after the scheduler ABI extension.
        Seven-board RF and full firmware qualification remain required.
config NINLIL_CLOSED_PROBES_EXPERIMENTAL
    bool "Route using finalized probe windows and measured queue residence"
    default n
    help
        Connect actual TX completion, applied power, authenticated replies and
        queue residence to the existing observation and Coordinator route cost.
        No reply is classified before its three-second window closes. Routing
        uses the latest eight completed trials; power-policy independent windows
        remain separate. Legacy power adaptation is unchanged. Receive PHY,
        credentials, packet formats and durable message ownership are unchanged.
        Requires a full consumer rebuild and the seven-board acceptance gate.
config NINLIL_RADIO_FEEDBACK_EXPERIMENTAL
    bool "Use confirmed, non-overlapping neighbor probe windows for TX power"
    default n
    help
        Opt-in actual node/pump integration. The driver stages TX power;
        only TX_DONE with matching applied output confirms a new generation.
        Authenticated neighbor replies feed eight-trial, non-overlapping
        windows. Sleep invalidates unfinished measurements without RF loss.
        Bootstrap/control floods remain at the reviewed maximum output.
        Does not change frequency, modulation, membership or remote routing
        observation formats. Actual ESP-IDF and seven-board RF gates remain.
config NINLIL_ROUTE_CANDIDATES_EXPERIMENTAL
    bool "Use bounded fixed-PHY candidate search on Root"
    depends on NINLIL_CLOSED_PROBES_EXPERIMENTAL
    default n
    help
        Root alone attaches a 16-node/64-edge workspace. Each node step performs
        up to 64 search units; no global optimum, calibrated capacity or SLO
        claim. Requires fresh directed observations in both hop directions.
        All existing prepare/commit/reconcile/lease and RF limits remain.
        Participant firmware reserves the same optional workspace but does not
        use it. Measure whole-firmware RAM and RF before acceptance.
endmenu
```

## embedded/esp32s3/main/Kconfig.projbuild
```kconfig
menu "Ninlil M1"

choice NINLIL_M1_MODE
    prompt "Firmware mode"
    default NINLIL_M1_MODE_DIAGNOSTIC

config NINLIL_M1_MODE_DIAGNOSTIC
    bool "M1.1 diagnostic PING/PONG"

config NINLIL_M1_MODE_DELIVERY
    bool "M1.2/M1.3 durable direct delivery"
endchoice

config NINLIL_NODE_ID
    int "Local node id"
    range 1 65534
    default 1

config NINLIL_PEER_ID
    int "Peer node id"
    range 1 65534
    default 2

config NINLIL_DIAGNOSTIC_INITIATOR
    bool "Initiate diagnostic PING packets"
    default n
    depends on NINLIL_M1_MODE_DIAGNOSTIC

config NINLIL_DIAGNOSTIC_PING_COUNT
    int "Diagnostic PING campaign count"
    range 1 10000
    default 1000
    depends on NINLIL_DIAGNOSTIC_INITIATOR

config NINLIL_RADIO_INIT_CYCLES
    int "Radio initialization cycles before campaign"
    range 1 100
    default 1

config NINLIL_DELIVERY_SUBMIT_ON_BOOT
    bool "Run durable HIL delivery batch"
    default n
    depends on NINLIL_M1_MODE_DELIVERY

config NINLIL_DELIVERY_MESSAGE_COUNT
    int "Durable HIL delivery message count"
    range 1 100
    default 100
    depends on NINLIL_M1_MODE_DELIVERY

config NINLIL_RF_TX_ENABLE
    bool "Enable RF transmission (requires local legal/HIL review)"
    default n

config NINLIL_RF_GATE_POLARITY_CONFIRMED
    bool "GPIO38 RF gate polarity confirmed on this exact B2B board"
    default n

config NINLIL_RF_GATE_RX_ACTIVE_HIGH
    bool "GPIO38 high selects receive path"
    default y

config NINLIL_RF_REGION
    string "Local regional/HIL profile label"
    default ""

config NINLIL_RF_FREQUENCY_HZ
    int "RF frequency in Hz (0 disables operational RX/TX)"
    range 0 1000000000
    default 0

config NINLIL_RF_TX_POWER_DBM
    int "SX1262 TX power in dBm"
    range -9 22
    default -9

config NINLIL_RF_SF
    int "LoRa spreading factor"
    range 5 12
    default 9

choice NINLIL_RF_BW
    prompt "LoRa bandwidth"
    default NINLIL_RF_BW_125
config NINLIL_RF_BW_125
    bool "125 kHz"
config NINLIL_RF_BW_250
    bool "250 kHz"
config NINLIL_RF_BW_500
    bool "500 kHz"
endchoice

config NINLIL_RF_CR_DENOMINATOR
    int "LoRa coding rate denominator (4/x)"
    range 5 8
    default 5

config NINLIL_RF_PREAMBLE_SYMBOLS
    int "LoRa preamble symbols"
    range 6 65535
    default 8

endmenu
```
